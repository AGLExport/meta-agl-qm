## conf/distro/poky-agl-core.conf
```bitbake
require conf/distro/poky.conf

# AGL specific derivations
DISTRO = "poky-agl-core"
DISTRO_NAME = "Automotive Grade Linux"

DISTRO_VERSION = "0.0.1"
DISTRO_CODENAME = "qm"

# SDK
SDK_VENDOR = "-aglsdk"
SDK_VERSION := "${@'${DISTRO_VERSION}'.replace('snapshot-${DATE}','snapshot')}"

# SDKPATH is the folder where the SDK is going to be installed
# Due to an issue with the qt5 environment (see SPEC-1667),
# we add DEFAULTTUNE to the SDKPATH to mitigate the issue.
SDKPATH = "/opt/agl-sdk/${SDK_VERSION}-${DEFAULTTUNE}"

# Override these in poky based distros
DISTRO_FEATURES := "systemd"
DISTRO_FEATURES_remove = "sysvinit"

# Mirrors is not set
#PREMIRRORS ??= "\
#               "
#MIRRORS =+ "\
#           "

PREFERRED_PROVIDER_udev ?= "systemd"
PREFERRED_PROVIDER_udev-utils ?= "systemd"

VIRTUAL-RUNTIME_init_manager = "systemd"
VIRTUAL-RUNTIME_initscripts = ""

# network manager to use (possible values: systemd, connman)
VIRTUAL-RUNTIME_net_manager = "systemd" 
```

## conf/layer.conf
```bitbake
# We have a conf and classes directory, add to BBPATH
BBPATH =. "${LAYERDIR}:"

# We have recipes-* directories, add to BBFILES
BBFILES += "${LAYERDIR}/recipes-*/*/*.bb \
            ${LAYERDIR}/recipes-*/*/*.bbappend"

BBFILE_COLLECTIONS += "agl-qm"
BBFILE_PATTERN_agl-qm = "^${LAYERDIR}/"
BBFILE_PRIORITY_agl-qm = "25"
LAYERSERIES_COMPAT_agl-qm = "dunfell"
```
